
#include "sh1122.h"
#include "spi.h"
#include <stdio.h>

//static uint8_t A[] = { 0x00,0x00,0x00,0x00,0x00,0x00,0x03,0xC0,0x03,0xC0,0x07,0xC0,0x07,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0x00,0x00 };
static uint8_t FONT[] = {
		0x00,0x00,0x00,0x00,0x00,0x00,0x00,0x00,0x00,0x00,0x00,0x00,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0x00,  // <space>
		0x00,0x00,0x00,0x00,0x00,0x00,0x01,0xC0,0x01,0xC0,0x01,0xC0,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0x00,  // !
		0x00,0x00,0x00,0x00,0x06,0x18,0x06,0x18,0x0E,0x38,0x0E,0x38,0x1E,0x78,0x1C,0x70,0x1C,0x70,0x1C,0x70,0x1C,0x70,0x1C,0x70,0x00,0x00,0x00,0x00,0x00,0x00,0x00,0x00,0x00,0x00,0x00,0x00,0x00,0x00,0x00,0x00,0x00,0x00,0x00,0x00,0x00,0x00,0x00,0x00,0x00,0x00,0x00,0x00,0x00,0x00,0x00,0x00,0x00,0x00,0x00,0x00,0x00,0x00,0x00,0x00,  // "
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		0x00,0x00,0x00,0x00,0x00,0x00,0x00,0x00,0x00,0x00,0x00,0x00,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0x00,  // _

};

static const uint8_t FONT_BOLD[] = {
		0x00,0x00,0x00,0x00,0x00,0x00,0x00,0x00,0x00,0x00,0x00,0x00,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0x00,  // <space>
		0x00,0x00,0x00,0x00,0x00,0x00,0x03,0xC0,0x03,0xC0,0x03,0xC0,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0x00,  // !
		0x00,0x00,0x00,0x00,0x0E,0x1C,0x0E,0x1C,0x1E,0x3C,0x1E,0x38,0x1C,0x78,0x3C,0x78,0x3C,0x78,0x3C,0x78,0x3C,0x78,0x3C,0x78,0x3C,0x78,0x00,0x00,0x00,0x00,0x00,0x00,0x00,0x00,0x00,0x00,0x00,0x00,0x00,0x00,0x00,0x00,0x00,0x00,0x00,0x00,0x00,0x00,0x00,0x00,0x00,0x00,0x00,0x00,0x00,0x00,0x00,0x00,0x00,0x00,0x00,0x00,0x00,0x00,  // "
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		0x00,0x00,0x00,0x00,0x00,0x00,0x00,0x00,0x00,0x00,0x00,0x00,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0x00,  // _

};


static uint8_t sh_buffer[SH_WIDTH * SH_HEIGHT / 2];

static void SH_cmdb(uint8_t cmd)
{
	SH_CMD_PROCESS;
	HAL_SPI_Transmit(&sh1122_spi, &cmd, 1, HAL_MAX_DELAY);
}

static void SH_cmdbb(uint8_t cmd_h, uint8_t cmd_l)
{
	SH_CMD_PROCESS;
	HAL_SPI_Transmit(&sh1122_spi, &cmd_h, 1, HAL_MAX_DELAY);
	HAL_Delay(1);
	HAL_SPI_Transmit(&sh1122_spi, &cmd_l, 1, HAL_MAX_DELAY);
	HAL_Delay(1);
}

static void SH_tmp(void)
{
	//0x00,0x00,0x00,0x00,0x01,0x00,0x02,0x80,0x02,0x80,0x04,0x40,0x04,0x40,0x04,0x40,0x08,0x20,0x0F,0xE0,0x10,0x10,0x10,0x10,0x20,0x08,0x20,0x08,0x00,0x00,0x00,0x00
	//for (int i = 0; i < 8; i++) {
		//if (A[4] & (1 << (7 - i))) SH_putPixel(i, 2, 15);
		//if (A[5] & (1 << (7 - i))) SH_putPixel(i + 8, 2, 15);

		//if (A[6] & (1 << (7 - i))) SH_putPixel(i, 3, 15);
		//if (A[7] & (1 << (7 - i))) SH_putPixel(i + 8, 3, 15);
	//}

	uint8_t f = 0;
	for (int z = 16; z < 26; z++) {
		for (int i = 0; i < 32; i++) {
			for (int j = 0; j < 2; j++) {
				for (int k = 0; k < 8; k++) {
					if (FONT[j + i*2 + z*64] & (1 << (7 - k))) SH_putPixel(k + j*8 + f, i, 15);
					if (FONT_BOLD[j + i*2 + z*64] & (1 << (7 - k))) SH_putPixel(k + j*8 + f, i + 32, 15);
				}
			}
		}
		f += 20;
	}
}

static void SH_rst(void)
{
	HAL_GPIO_WritePin(SH_RST_PORT, SH_RST_PIN, GPIO_PIN_RESET);
	HAL_Delay(1);
	HAL_GPIO_WritePin(SH_RST_PORT, SH_RST_PIN, GPIO_PIN_SET);
	HAL_Delay(200);
}

static void SH_clrRAM(void)
{
	SH_DATA_PROCESS;
	HAL_Delay(100);

	for (int i = 0; i < SH_HEIGHT; i++)
		for (int j = 0; j < SH_WIDTH; j++)
			SH_putPixel(j, i, 0x00);

	SH_update();
}

static void SH_displayDateChars(void)
{
	SH_drawString(24, 50, "DAYS", 15);
	SH_drawString(87, 50, "MIN",  15);
	SH_drawString(146, 50, "HRS",  15);
	SH_drawString(207, 50, "SEC",  15);
}

void SH_background(uint8_t color)
{
	for (int i = 0; i < SH_WIDTH; i++)
		for (int j = 0; j < SH_HEIGHT; j++)
			SH_putPixel(i, j, color);

	SH_update();
}

void SH_putPixel(int x, int y, uint8_t color)
{
	if ((x & 0x01) == 0) {
		sh_buffer[(x + y*SH_WIDTH) / 2] &= 0x0F;
		sh_buffer[(x + y*SH_WIDTH) / 2] |= ((color & 0x0F) << 4);
	}
	else {
		sh_buffer[(x + y*SH_WIDTH) / 2] &= 0xF0;
		sh_buffer[(x + y*SH_WIDTH) / 2] |= (color & 0x0F);
	}
}

void SH_update(void)
{

	SH_setRowAdr(0);
	SH_setColumn(0);
	//SH_setDispLine(0);

	SH_DATA_PROCESS;
	HAL_Delay(100);

	SPI_START;
	HAL_SPI_Transmit(&sh1122_spi, sh_buffer, SH_WIDTH * SH_HEIGHT / 2, HAL_MAX_DELAY);
	SPI_STOP;
}

void SH_init(void)
{
	SH_rst();

	//SH_setContrast(200);
	SH_clrRAM();
	SH_setDispPower(1);
	HAL_Delay(100);

	//SH_displayDateChars();
	SH_tmp();
}

void SH_setColumn(uint8_t column)
{
	column &= 0x7F;
	uint8_t col_h = (column >> 4) | 0x10;
	uint8_t col_l = column & 0x0F;

	SPI_START;
	SH_cmdbb(col_h, col_l);
	SPI_STOP;
}

void SH_setDispLine(uint8_t line)
{
	line &= 0x3F;

	SPI_START;
	SH_cmdb(line);
	SPI_STOP;
}

void SH_setContrast(uint8_t contrast)
{
	uint8_t contrast_msb = 0x81;

	SPI_START;
	SH_cmdbb(contrast_msb, contrast);
	SPI_STOP;
}

void SH_setRemap(uint8_t remap)
{
	remap &= 0x01;

	SPI_START;
	SH_cmdb(remap | 0xA0);
	SPI_STOP;
}

void SH_setEntireDisp(uint8_t state)
{
	state &= 0x01;

	SPI_START;
	SH_cmdb(state | 0xA4);
	SPI_STOP;
}

void SH_setDispMode(uint8_t mode)
{
	mode &= 0x01;

	SPI_START;
	SH_cmdb(mode | 0xA6);
	SPI_STOP;
}

void SH_setDispPower(uint8_t power)
{
	power &= 0x01;

	SPI_START;
	SH_cmdb(power | 0xAE);
	SPI_STOP;
}

void SH_setOffset(uint8_t offset)
{
	uint8_t offset_msb = 0xD3;
	offset &= 0x3F;

	SPI_START;
	SH_cmdbb(offset_msb, offset);
	SPI_STOP;
}

void SH_drawHLine(int x0, int y,  int width, uint8_t color)
{
	for (int i = 0; i < width; i++)
		SH_putPixel(i + x0, y, color);
}

void SH_drawVLine(int x,  int y0, int height, uint8_t color)
{
	for (int i = 0; i < height; i++)
		SH_putPixel(x, i + y0, color);
}

void SH_drawRectangle(int x0, int y0, int width, int height, uint8_t color)
{
	SH_drawHLine(x0, y0, width, color);
	SH_drawHLine(x0, y0 + height, width, color);

	SH_drawVLine(x0, y0, height, color);
	SH_drawVLine(x0 + width, y0, height, color);
}

void SH_setRowAdr(uint8_t row)
{
	uint8_t row_msb = 0xB0;
	row &= 0x3F;

	SPI_START;
	SH_cmdbb(row_msb, row);
	SPI_STOP;
}

void SH_drawString(int x, int y, char *s, uint8_t color)
{
	uint8_t i = 0;
	while (*s) {
		if ((*s >= 65) && (*s <= 90))
			SH_drawChar(i + x, y, *s, color);
		i += 8;
		s++;
	}
}

void SH_drawChar(int x, int y, uint8_t ch, uint8_t color)
{

}

void SH_displayTime(int d, uint8_t h, uint8_t m, uint8_t s)
{
	SH_drawChar(20, 10, d / 10, 15);
	SH_drawChar(40, 10, d % 10, 15);

	SH_drawChar(60, 10, 10, 15);

	SH_drawChar(80, 10, h / 10, 15);
	SH_drawChar(100, 10, h % 10, 15);

	SH_drawChar(120, 10, 10, 15);

	SH_drawChar(140, 10, m / 10, 15);
	SH_drawChar(160, 10, m % 10, 15);

	SH_drawChar(180, 10, 10, 15);

	SH_drawChar(200, 10, s / 10, 15);
	SH_drawChar(220, 10, s % 10, 15);
}
